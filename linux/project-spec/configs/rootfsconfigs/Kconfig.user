## linux/project-spec/configs/rootfsconfigs/Kconfig.user
```kconfig
menu "user packages " 
config apache2  
	 bool "apache2"
	 help
	
config axidma  
	 bool "axidma"
	 help
	
config gdbserver-service  
	 bool "gdbserver-service"
	 help
	
config gpio-demo  
	 bool "gpio-demo"
	 help
	
config mariadb  
	 bool "mariadb"
	 help
	
config peekpoke  
	 bool "peekpoke"
	 help
	
config php  
	 bool "php"
	 help
	
config phpmyadmin  
	 bool "phpmyadmin"
	 help
	
endmenu
```
